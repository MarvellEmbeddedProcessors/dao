## bfs/Config.in
```kconfig
# SPDX-License-Identifier: Marvell-MIT
# Copyright (c) 2025 Marvell.

config BR2_MARVELL_CNXK_SOC
	string "Marvell CNXK SoC: OCTEON9 or OCTEON10"
	help
	SoC family string: OCTEON9 or OCTEON10

config BR2_MARVELL_SOC_IS_OCTEON10
	bool
	default y if BR2_MARVELL_CNXK_SOC = "OCTEON10"

config BR2_MARVELL_SOC_IS_OCTEON9
	bool
	default y if BR2_MARVELL_CNXK_SOC = "OCTEON9"

config BR2_MARVELL_MESON_PROPERTIES_PLATFORM
	string "Meson platform string under properties section of meson config file"
	default "cn9k" \
		if BR2_aarch64 && BR2_MARVELL_SOC_IS_OCTEON9
	default "cn10k" \
		if BR2_aarch64 && BR2_MARVELL_SOC_IS_OCTEON10

config BR2_MARVELL_MESON_PROPERTIES_MACHINE_ARGS
	string "Meson machine_args string under properties section of meson config file"
	default "octeontx2+crc+crypto+lse" \
		if BR2_aarch64 && BR2_MARVELL_SOC_IS_OCTEON9
	default "neoverse-n2" \
		if BR2_aarch64 && BR2_MARVELL_SOC_IS_OCTEON10

source "$BR2_EXTERNAL_MRVL_PATH/package/marvell-dpdk/Config.in"
source "$BR2_EXTERNAL_MRVL_PATH/package/dao/Config.in"
```

## bfs/configs/octeon_cn9k_defconfig
```kconfig
# Marvell DAO Buildroot 2024.11.1 Configuration

#BR2_GLOBAL_PATCH_DIR="$(BR2_EXTERNAL_MRVL_PATH)/patches"
BR2_generic=y
BR2_MARVELL_CNXK_SOC="OCTEON9"
BR2_aarch64=y
BR2_OPTIMIZE_2=y
# CFLAGS/LDFLAGS
BR2_TARGET_CFLAGS="-mcpu=octeontx2 -zmuldefs -fcommon"
BR2_TARGET_LDFLAGS="-zmuldefs -zcommon"
BR2_TOOLCHAIN_EXTERNAL=y
BR2_TOOLCHAIN_EXTERNAL_CUSTOM=y
BR2_TOOLCHAIN_EXTERNAL_PREINSTALLED=y
BR2_TOOLCHAIN_EXTERNAL_PATH="$(BR2_EXTERNAL_MRVL_PATH)/../../toolchain/"
BR2_TOOLCHAIN_EXTERNAL_FIXUP_SYSROOT_SCRIPT="$(BR2_EXTERNAL_MRVL_PATH)/board/toolchain-fixup.sh"
BR2_TOOLCHAIN_EXTERNAL_CUSTOM_PREFIX="aarch64-marvell-linux-gnu"
BR2_TOOLCHAIN_EXTERNAL_GCC_13=y
BR2_TOOLCHAIN_EXTERNAL_INET_RPC=n
BR2_TOOLCHAIN_EXTERNAL_HEADERS_4_14=y
BR2_TOOLCHAIN_EXTERNAL_CUSTOM_GLIBC=y
BR2_TOOLCHAIN_EXTERNAL_CXX=y
BR2_TOOLCHAIN_EXTERNAL_FORTRAN=y
BR2_TOOLCHAIN_EXTERNAL_OPENMP=y

# Kernel
BR2_ARM64_PAGE_SIZE_64K=y

BR2_LINUX_KERNEL=y
BR2_LINUX_KERNEL_INSTALL_TARGET=y
BR2_LINUX_KERNEL_CUSTOM_TARBALL=y
BR2_LINUX_KERNEL_CUSTOM_TARBALL_LOCATION="https://github.com/MarvellEmbeddedProcessors/linux-marvell/archive/refs/tags/linux-6.1.x-release-v25.03.tar.gz"
BR2_LINUX_KERNEL_VERSION="6.1.x-release-v25.03"
BR2_LINUX_KERNEL_PATCH=""
BR2_LINUX_KERNEL_USE_CUSTOM_CONFIG=y
BR2_LINUX_KERNEL_CUSTOM_CONFIG_FILE="$(BR2_EXTERNAL_MRVL_PATH)/board/octeon_cn9k/linux.config"
BR2_LINUX_KERNEL_IMAGE=y
BR2_LINUX_KERNEL_GZIP=y

BR2_TARGET_GENERIC_HOSTNAME="dao-mrvl-br2"
BR2_TARGET_GENERIC_ISSUE="Welcome to Marvell DAO Buildroot"

#Packages
BR2_TARGET_TZ_INFO=y
BR2_PACKAGE_BUSYBOX=y
BR2_PACKAGE_BUSYBOX_SHOW_OTHERS=y
BR2_PACKAGE_BUSYBOX_WATCHDOG=y
BR2_PACKAGE_CP_AGENT=y
BR2_PACKAGE_DAO=y
BR2_PACKAGE_FIRMWARE=y

#--- Mainline packages (BenchMark) ---
BR2_TARGET_GENERIC_GETTY_BAUDRATE_115200=y
BR2_PACKAGE_DT=y
BR2_PACKAGE_IOZONE=y
BR2_PACKAGE_LMBENCH=n
BR2_PACKAGE_NETPERF=n
BR2_PACKAGE_STRACE=y
BR2_PACKAGE_STRESS=y
BR2_PACKAGE_TRACE_CMD=y
BR2_PACKAGE_FLEX=y
BR2_PACKAGE_LIBTOOL=y
BR2_PACKAGE_MAKE=y
BR2_PACKAGE_BTRFS_PROGS=y
BR2_PACKAGE_CIFS_UTILS=y
BR2_PACKAGE_E2FSPROGS_RESIZE2FS=y
BR2_PACKAGE_MTD_DOCFDISK=y
BR2_PACKAGE_MTD_DOC_LOADBIOS=y
BR2_PACKAGE_MTD_FLASH_OTP_DUMP=y
BR2_PACKAGE_MTD_FLASH_OTP_INFO=y
BR2_PACKAGE_MTD_FLASH_OTP_LOCK=y
BR2_PACKAGE_MTD_FLASH_OTP_WRITE=y
BR2_PACKAGE_MTD_FTL_CHECK=y
BR2_PACKAGE_MTD_FTL_FORMAT=y
BR2_PACKAGE_MTD_JFFS2DUMP=y
BR2_PACKAGE_MTD_MKFSJFFS2=y
BR2_PACKAGE_MTD_MKFSUBIFS=y
BR2_PACKAGE_MTD_MTDPART=y
BR2_PACKAGE_MTD_TESTS=y
BR2_PACKAGE_MTD_FLASH_READTEST=y
BR2_PACKAGE_MTD_FLASH_SPEED=y
BR2_PACKAGE_MTD_FLASH_STRESS=y
BR2_PACKAGE_MTD_FLASH_TORTURE=y
BR2_PACKAGE_MTD_INTEGCK=y
BR2_PACKAGE_MTD_NANDBITERRS=y
BR2_PACKAGE_MTD_NANDPAGETEST=y
BR2_PACKAGE_MTD_NANDSUBPAGETEST=y
BR2_PACKAGE_MTD=y
BR2_PACKAGE_MTDEV=y
BR2_PACKAGE_XFSPROGS=y
BR2_PACKAGE_CRYPTSETUP=n
BR2_PACKAGE_DBUS=y
BR2_PACKAGE_HDPARM=y
BR2_PACKAGE_I2C_TOOLS=y
BR2_PACKAGE_LINUXCONSOLETOOLS=y
BR2_PACKAGE_LM_SENSORS=y
BR2_PACKAGE_LM_SENSORS_FANCONTROL=y
BR2_PACKAGE_LM_SENSORS_SENSORS_DETECT=y
BR2_PACKAGE_MDADM=n
BR2_PACKAGE_MEMTESTER=y
BR2_PACKAGE_NVME=n
BR2_PACKAGE_SDPARM=y
BR2_PACKAGE_SETSERIAL=y
BR2_PACKAGE_SYSSTAT=y
BR2_PACKAGE_WIPE=n
BR2_PACKAGE_PERL=n
BR2_PACKAGE_PERL_FILE_UTIL=n
BR2_PACKAGE_PERL_NET_DNS=n
BR2_PACKAGE_PERL_NET_HTTP=n
BR2_PACKAGE_PERL_XML_LIBXML=n
BR2_PACKAGE_LIBGCRYPT=y
BR2_PACKAGE_LIBOPENSSL_BIN=y
BR2_PACKAGE_LIBOPENSSL_ENGINES=n
BR2_PACKAGE_PIXMAN=n
BR2_PACKAGE_DTC=y
BR2_PACKAGE_DTC_PROGRAMS=y
BR2_PACKAGE_LIBUSB=y
BR2_PACKAGE_LIBCAP=y
BR2_PACKAGE_BC=n
BR2_PACKAGE_DHCP=n
BR2_PACKAGE_DHCP_RELAY=n
BR2_PACKAGE_EBTABLES=n
BR2_PACKAGE_IFENSLAVE=n
BR2_PACKAGE_IFTOP=n
BR2_PACKAGE_IFUPDOWN=y
BR2_PACKAGE_MII_DIAG=n
BR2_PACKAGE_NETCAT=n
BR2_PACKAGE_OPENSSH=y
BR2_PACKAGE_OPENSWAN=n
BR2_PACKAGE_PURE_FTPD=n
BR2_PACKAGE_RP_PPPOE=n
BR2_PACKAGE_TRACEROUTE=n
BR2_PACKAGE_TUNCTL=n
BR2_PACKAGE_FTOP=n
BR2_PACKAGE_PROCPS_NG=y
BR2_PACKAGE_PSMISC=y
BR2_PACKAGE_UTIL_LINUX_LOSETUP=n
BR2_PACKAGE_UTIL_LINUX_MORE=n
BR2_PACKAGE_UTIL_LINUX_MOUNT=y
BR2_PACKAGE_UTIL_LINUX_NOLOGIN=y
BR2_PACKAGE_UTIL_LINUX_NSENTER=n
BR2_PACKAGE_UTIL_LINUX_UNSHARE=n
BR2_PACKAGE_HOST_E2FSPROGS=y
BR2_PACKAGE_HOST_GENEXT2FS=y
BR2_PACKAGE_NUMACTL=n
BR2_PACKAGE_TAR=y
BR2_PACKAGE_SCREEN=y
BR2_PACKAGE_TPM2_TOOLS=n
BR2_PACKAGE_TPM2_ABRMD=n
BR2_PACKAGE_TPM2_TSS=n
BR2_PACKAGE_LIBSECCOMP=n
BR2_PACKAGE_LIBCONFIG=y

#--- Mainline packages (Netfilter, IPSEC, tools) ---
BR2_PACKAGE_LINUXPTP=n
BR2_PACKAGE_LINUX_TOOLS_CPUPOWER=y
BR2_PACKAGE_LINUX_TOOLS_GPIO=y
BR2_PACKAGE_LINUX_TOOLS_PERF=y
BR2_PACKAGE_GDB=n
BR2_PACKAGE_GDB_SERVER=n
BR2_PACKAGE_GDB_DEBUGGER=n
BR2_PACKAGE_KEXEC=y
BR2_PACKAGE_FINDUTILS=y
BR2_PACKAGE_GAWK=y
BR2_PACKAGE_PATCH=y
BR2_PACKAGE_SED=y
BR2_PACKAGE_TREE=n
BR2_PACKAGE_DOSFSTOOLS=y
BR2_PACKAGE_DOSFSTOOLS_FSCK_FAT=y
BR2_PACKAGE_DOSFSTOOLS_MKFS_FAT=y
BR2_PACKAGE_E2FSPROGS_E4DEFRAG=y
BR2_PACKAGE_E2TOOLS=y
BR2_PACKAGE_ECRYPTFS_UTILS=n
BR2_PACKAGE_EXFAT_UTILS=y
BR2_PACKAGE_GPTFDISK=y
BR2_PACKAGE_GPTFDISK_SGDISK=y
BR2_PACKAGE_LSHW=y
BR2_PACKAGE_MINICOM=y
BR2_PACKAGE_PARTED=y
BR2_PACKAGE_POWERTOP=y
BR2_PACKAGE_PYTHON3=n
BR2_PACKAGE_PYTHON_SSL=n
BR2_PACKAGE_PYTHON_PYEXPAT=n
BR2_PACKAGE_PYTHON_ZLIB=n
BR2_PACKAGE_GNUTLS=n
BR2_PACKAGE_GNUTLS_TOOLS=n
BR2_PACKAGE_LIBGLIB2=y
BR2_PACKAGE_LIBNFSIDMAP=n
BR2_PACKAGE_LIBNETFILTER_ACCT=n
BR2_PACKAGE_LIBNETFILTER_LOG=n
BR2_PACKAGE_LIBNFTNL_JSON=n
BR2_PACKAGE_COLLECTD=y
BR2_PACKAGE_COLLECTD_CONNTRACK=n
BR2_PACKAGE_COLLECTD_IPTABLES=y
BR2_PACKAGE_BIND=n
BR2_PACKAGE_BIND_TOOLS=n
BR2_PACKAGE_CONNTRACK_TOOLS=n
BR2_PACKAGE_DHCP_SERVER=n
BR2_PACKAGE_DHCPDUMP=n
BR2_PACKAGE_DNSMASQ=n
BR2_PACKAGE_DNSMASQ_DNSSEC=n
BR2_PACKAGE_DNSMASQ_IDN=n
BR2_PACKAGE_DNSMASQ_CONNTRACK=n
BR2_PACKAGE_DRBD_UTILS=n
BR2_PACKAGE_ELFUTILS=y
BR2_PACKAGE_IPERF=n
BR2_PACKAGE_IPTABLES_NFTABLES=y
BR2_PACKAGE_MROUTED=n
BR2_PACKAGE_NCFTP=n
BR2_PACKAGE_NFACCT=n
BR2_PACKAGE_NFTABLES=y
BR2_PACKAGE_NGREP=n
BR2_PACKAGE_NLOAD=n
BR2_PACKAGE_NMAP=n
BR2_PACKAGE_NMAP_NCAT=n
BR2_PACKAGE_NMAP_NMAP=n
BR2_PACKAGE_NMAP_NPING=n
BR2_PACKAGE_NTP=n
BR2_PACKAGE_PPPD_FILTER=n
BR2_PACKAGE_PROXYCHAINS_NG=n
BR2_PACKAGE_SAMBA4=n
BR2_PACKAGE_STRONGSWAN=n
BR2_PACKAGE_STRONGSWAN_AF_ALG=n
BR2_PACKAGE_STUNNEL=y
BR2_PACKAGE_TCPING=n
BR2_PACKAGE_TCPREPLAY=n
BR2_PACKAGE_THTTPD=n
BR2_PACKAGE_UDPCAST=n
BR2_PACKAGE_UDPCAST_SENDER=n
BR2_PACKAGE_UDPCAST_RECEIVER=n
BR2_PACKAGE_WGET=y
BR2_PACKAGE_COREUTILS=y
BR2_PACKAGE_IOTOP=n
BR2_PACKAGE_IRQBALANCE=n
BR2_PACKAGE_UTIL_LINUX_SCHEDUTILS=y
BR2_PACKAGE_NANO=n
BR2_PACKAGE_VIM=y
BR2_PACKAGE_GPSD=n
#BR2_PACKAGE_OVERRIDE_FILE="$(TOPDIR)/../override_srcdir.mk"
```

## bfs/package/cp_agent/Config.in
```kconfig
# SPDX-License-Identifier: Marvell-MIT
# Copyright (c) 2025 Marvell.

config BR2_PACKAGE_CP_AGENT
	bool "Marvell CP AGENT"
	default y if BR2_aarch64
	select BR2_PACKAGE_LIBCONFIG
	select BR2_PACKAGE_PKGCONF
	help
		This is the octep_cp_agent package.

if BR2_PACKAGE_CP_AGENT

config BR2_PACKAGE_CP_AGENT_CONFIG
	string "CP Agent Configuration filename"
	default "arm64_cn9k_linux_gcc" \
		if BR2_aarch64 && BR2_MARVELL_SOC_IS_OCTEON9
	default "arm64_cn10k_linux_gcc" \
		if BR2_aarch64 && BR2_MARVELL_SOC_IS_OCTEON10

endif
```

## bfs/package/dao/Config.in
```kconfig
# SPDX-License-Identifier: Marvell-MIT
# Copyright (c) 2025 Marvell.

config BR2_PACKAGE_DAO_ARCH_SUPPORTS
	bool
	default y if BR2_aarch64

config BR2_PACKAGE_DAO
	bool "Marvell DAO"
	default y if BR2_PACKAGE_DAO_ARCH_SUPPORTS
	select BR2_PACKAGE_MARVELL_DPDK
	select BR2_PACKAGE_GRPC

if BR2_PACKAGE_DAO

config BR2_PACKAGE_DAO_DEBUG_BUILD
	bool
	default n
	prompt "Generate DAO for debugging."

config BR2_PACKAGE_DAO_CONFIG
	string "DAO Configuration filename"
	default "arm64_cn9k_linux_gcc" \
		if BR2_aarch64 && BR2_MARVELL_SOC_IS_OCTEON9
	default "arm64_cn10k_linux_gcc" \
		if BR2_aarch64 && BR2_MARVELL_SOC_IS_OCTEON10

endif

comment "DAO needs aarch64 or x86 arch"
	depends on BR2_PACKAGE_DAO_ARCH_SUPPORTS
```

## bfs/package/firmware/Config.in
```kconfig
# SPDX-License-Identifier: Marvell-MIT
# Copyright (c) 2025 Marvell.

config BR2_PACKAGE_FIRMWARE
	bool "Marvell Firmware"
	default y if BR2_PACKAGE_DAO
	help
		This is the Marvell firmware package.
```

## bfs/package/liboqs/Config.in
```kconfig
# SPDX-License-Identifier: Marvell-MIT
# Copyright (c) 2025 Marvell.

config BR2_PACKAGE_LIBOQS_ARCH_SUPPORTS
	bool
	# liboqs supports these architectures
	default y if BR2_aarch64
	default y if BR2_aarch64_be
	default y if BR2_x86_64
	default y if BR2_i386

config BR2_PACKAGE_LIBOQS
	bool "liboqs"
	depends on BR2_PACKAGE_LIBOQS_ARCH_SUPPORTS
	depends on BR2_TOOLCHAIN_HAS_THREADS
	depends on BR2_USE_MMU
	depends on BR2_TOOLCHAIN_GCC_AT_LEAST_4_9
	depends on BR2_TOOLCHAIN_HAS_SYNC_4
	depends on BR2_INSTALL_LIBSTDCPP
	select BR2_PACKAGE_HOST_CMAKE
	help
	  liboqs is an open source C library for quantum-safe cryptographic
	  algorithms. It provides implementations of key encapsulation mechanisms
	  (KEMs) and digital signature schemes that are designed to resist attacks
	  by both classical and quantum computers.

	  The library includes implementations of quantum-safe algorithms that
	  have been submitted to NIST's Post-Quantum Cryptography standardization
	  process, including Kyber, Dilithium, Falcon, and SPHINCS+.

	  https://github.com/open-quantum-safe/liboqs

if BR2_PACKAGE_LIBOQS

config BR2_PACKAGE_LIBOQS_ENABLE_OPENSSL
	bool "Enable OpenSSL integration"
	select BR2_PACKAGE_OPENSSL
	default y
	help
	  Enable OpenSSL integration for additional cryptographic functions
	  and performance optimizations.

config BR2_PACKAGE_LIBOQS_BUILD_TESTS
	bool "Build test programs"
	default n
	help
	  Build liboqs test programs. Useful for validation and debugging.

config BR2_PACKAGE_LIBOQS_BUILD_EXAMPLES
	bool "Build example programs"
	default n
	help
	  Build liboqs example programs demonstrating usage of quantum-safe
	  cryptographic algorithms.

comment "CPU Instruction Set Optimizations"

config BR2_PACKAGE_LIBOQS_ENABLE_AES_NI
	bool "Enable AES-NI instructions"
	depends on BR2_x86_64 || BR2_i386
	default y if BR2_x86_64
	help
	  Enable AES-NI instructions for x86/x86_64 platforms for better
	  performance in AES operations.

config BR2_PACKAGE_LIBOQS_ENABLE_AVX
	bool "Enable AVX instructions"
	depends on BR2_x86_64 || BR2_i386
	default y if BR2_x86_64
	help
	  Enable AVX instructions for x86/x86_64 platforms for better
	  performance in cryptographic operations.

config BR2_PACKAGE_LIBOQS_ENABLE_AVX2
	bool "Enable AVX2 instructions"
	depends on BR2_x86_64 || BR2_i386
	default y if BR2_x86_64
	help
	  Enable AVX2 instructions for x86/x86_64 platforms for better
	  performance in cryptographic operations.

config BR2_PACKAGE_LIBOQS_ENABLE_NEON
	bool "Enable ARM NEON instructions"
	depends on BR2_aarch64 || BR2_aarch64_be || BR2_arm
	default y if BR2_aarch64
	help
	  Enable ARM NEON instructions for ARM platforms for better
	  performance in cryptographic operations.

comment "Key Encapsulation Mechanisms (KEMs)"

config BR2_PACKAGE_LIBOQS_ENABLE_KEM_CLASSIC_MCELIECE
	bool "Enable Classic McEliece KEM"
	default y
	help
	  Enable Classic McEliece key encapsulation mechanism.
	  This is a code-based post-quantum cryptographic algorithm.

config BR2_PACKAGE_LIBOQS_ENABLE_KEM_KYBER
	bool "Enable Kyber KEM"
	default y
	help
	  Enable Kyber key encapsulation mechanism.
	  This is a lattice-based post-quantum cryptographic algorithm
	  that is part of NIST's selected algorithms.

config BR2_PACKAGE_LIBOQS_ENABLE_KEM_FRODOKEM
	bool "Enable FrodoKEM"
	default y
	help
	  Enable FrodoKEM key encapsulation mechanism.
	  This is a lattice-based post-quantum cryptographic algorithm.

comment "Digital Signature Algorithms"

config BR2_PACKAGE_LIBOQS_ENABLE_SIG_DILITHIUM
	bool "Enable Dilithium signatures"
	default y
	help
	  Enable Dilithium digital signature algorithm.
	  This is a lattice-based post-quantum signature scheme
	  that is part of NIST's selected algorithms.

config BR2_PACKAGE_LIBOQS_ENABLE_SIG_FALCON
	bool "Enable Falcon signatures"
	default y
	help
	  Enable Falcon digital signature algorithm.
	  This is a lattice-based post-quantum signature scheme
	  that is part of NIST's selected algorithms.

config BR2_PACKAGE_LIBOQS_ENABLE_SIG_SPHINCS
	bool "Enable SPHINCS+ signatures"
	default y
	help
	  Enable SPHINCS+ digital signature algorithm.
	  This is a hash-based post-quantum signature scheme
	  that is part of NIST's selected algorithms.

endif

comment "liboqs needs a toolchain w/ C++, threads, dynamic library, gcc >= 4.9"
	depends on BR2_USE_MMU
	depends on BR2_PACKAGE_LIBOQS_ARCH_SUPPORTS
	depends on !BR2_TOOLCHAIN_HAS_THREADS || \
		!BR2_INSTALL_LIBSTDCPP || \
		!BR2_TOOLCHAIN_GCC_AT_LEAST_4_9 || \
		!BR2_TOOLCHAIN_HAS_SYNC_4
```
