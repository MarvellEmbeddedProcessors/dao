## bfs/package/marvell-dpdk/Config.in
```kconfig
# SPDX-License-Identifier: Marvell-MIT
# Copyright (c) 2025 Marvell.

config BR2_PACKAGE_MARVELL_DPDK_ARCH_SUPPORTS
	bool
	# DPDK can be used for the following little endian architecture
	default y if BR2_aarch64
	# DPDK requires SSE4.2 for x86_64 since v17.08
	default y if BR2_x86_64 && BR2_X86_CPU_HAS_SSE42

config BR2_PACKAGE_MARVELL_DPDK
	bool "Marvell dpdk"
	depends on BR2_PACKAGE_MARVELL_DPDK_ARCH_SUPPORTS
	depends on BR2_TOOLCHAIN_HAS_THREADS # DPDK design
	depends on BR2_USE_MMU # pthread() memory mappings
	depends on BR2_TOOLCHAIN_GCC_AT_LEAST_4_9 # C11/stdatomic.h
	depends on BR2_TOOLCHAIN_HEADERS_AT_LEAST_4_14
	depends on BR2_TOOLCHAIN_USES_GLIBC
	select BR2_PACKAGE_HOST_PYTHON3 # host-python-pyelftools
	help
	  DPDK (Data Plane Development Kit) is a set of libraries
	  and drivers for fast packet processing.

	  http://dpdk.org/

	  Optional but recommended kernel configurations:
	    - CONFIG_VFIO_IOMMU_TYPE1
	    - CONFIG_VFIO_VIRQFD
	    - CONFIG_VFIO
	    - CONFIG_VFIO_NOIOMMU
	    - CONFIG_VFIO_PCI
	    - CONFIG_VFIO_PCI_MMAP
	    - CONFIG_HUGETLBFS
	    - CONFIG_HUGETLB_PAGE
	    - CONFIG_PROC_PAGE_MONITOR

	  For x86 only, the following can also be useful:
	    - CONFIG_HPET
	    - CONFIG_HPET_MMAP

if BR2_PACKAGE_MARVELL_DPDK

config BR2_PACKAGE_MARVELL_DPDK_EXAMPLES
	bool "Install examples"
	default n
	help
	  "Add DPDK examples as part of target rootfs"

config BR2_PACKAGE_MARVELL_DPDK_TESTS
	bool "Install tests"

config BR2_PACKAGE_MARVELL_DPDK_DEBUG_BUILD
	bool
	default n
	prompt "Generate DPDK for debugging."
	help
	  "Useful for source-level debugging of DPDK (with gdb)."

config BR2_PACKAGE_MARVELL_DPDK_ENABLE_FPIC
	bool
	default y
	prompt "Compile Marvell DPDK with fPIC"
	help
	  "Useful for linking DPDK libraries with shared libraries."

config BR2_PACKAGE_MARVELL_DPDK_CONFIG
	string "DPDK Configuration filename"
	default "arm64_cn9k_linux_gcc" \
		if BR2_aarch64 && BR2_MARVELL_SOC_IS_OCTEON9
	default "arm64_cn10k_linux_gcc" \
		if BR2_aarch64 && BR2_MARVELL_SOC_IS_OCTEON10
	default "i686-native-linuxapp-gcc" \
		if BR2_x86_i686
	default "x86_64-native-linuxapp-gcc" \
		if BR2_x86_64
	default "arm64-armv8a-linuxapp-gcc" \
		if BR2_aarch64 || BR2_aarch64_be

config BR2_PACKAGE_MARVELL_DPDK_BUILD_MINIMAL
	bool
	default n
	prompt "Generate DPDK with minimal libraries"
	help
	  "Useful for reducing build size."

endif

comment "MARVELL_DPDK needs a toolchain w/ dynamic library, threads, wchar, kernel headers >= 4.19"
	depends on BR2_USE_MMU # pthread() memory mappings
	depends on BR2_PACKAGE_MARVELL_DPDK_ARCH_SUPPORTS
	depends on !BR2_TOOLCHAIN_HAS_THREADS || \
		!BR2_TOOLCHAIN_USES_GLIBC || \
		!BR2_TOOLCHAIN_GCC_AT_LEAST_4_9 || \
		!BR2_TOOLCHAIN_HEADERS_AT_LEAST_4_14
```

## kmod/rdma/octep_rdma/Kconfig
```kconfig
# SPDX-License-Identifier: GPL-2.0
# Copyright (c) 2025 Marvell.

config INFINIBAND_OCTEP_RA
	tristate "Marvell Octeon EP RDMA Adapter (OCTEP_RA) support"
	depends on PCI_MSI && 64BIT
	depends on INFINIBAND_ADDR_TRANS
	depends on INFINIBAND_USER_ACCESS
	help
	  This is a RDMA/RoCE driver for Marvell Octeon EP RDMA Adapter
	  (OCTEP_RA) which supports RDMA features in cloud environment.

	  To compile this driver as module, choose M here. The module will be
	  called octep_ra.
```
